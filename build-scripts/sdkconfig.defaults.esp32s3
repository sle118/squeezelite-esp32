## build-scripts/sdkconfig.defaults.esp32s3
```kconfig
CONFIG_IDF_TARGET="esp32s3"
CONFIG_ESPTOOLPY_FLASHMODE_QIO=y
CONFIG_ESPTOOLPY_FLASHSIZE_8MB=y
CONFIG_PARTITION_TABLE_CUSTOM=y
CONFIG_LWIP_MAX_SOCKETS=20
CONFIG_BT_ENABLED=n
CONFIG_DEFAULT_COMMAND_LINE="squeezelite -o I2S -b 500:2000 -d all=info -C 30 -W"
CONFIG_WIFI_MANAGER_TASK_PRIORITY=5
CONFIG_DEFAULT_AP_SSID="squeezelite"
CONFIG_DEFAULT_AP_PASSWORD="squeezelite"
CONFIG_DEFAULT_AP_IP="192.168.4.1"
CONFIG_DEFAULT_AP_GATEWAY="192.168.4.1"
CONFIG_COMPILER_OPTIMIZATION_SIZE=y
CONFIG_COMPILER_CXX_EXCEPTIONS=y
CONFIG_SPI_MASTER_IN_IRAM=y
# CONFIG_SPI_SLAVE_ISR_IN_IRAM is not set
CONFIG_ESP_TLS_INSECURE=y
CONFIG_ESP_TLS_SKIP_SERVER_CERT_VERIFY=y
CONFIG_ESP32S3_DEFAULT_CPU_FREQ_240=y
CONFIG_ESP32S3_SPIRAM_SUPPORT=y
CONFIG_SPIRAM_MODE_OCT=y
CONFIG_SPIRAM_ALLOW_STACK_EXTERNAL_MEMORY=y
CONFIG_SPIRAM_SPEED_80M=y
CONFIG_SPIRAM_MALLOC_ALWAYSINTERNAL=256
CONFIG_SPIRAM_TRY_ALLOCATE_WIFI_LWIP=y
CONFIG_ETH_SPI_ETHERNET_DM9051=y
CONFIG_ETH_SPI_ETHERNET_W5500=y
CONFIG_HTTPD_MAX_REQ_HDR_LEN=1024
CONFIG_ESP_IPC_TASK_STACK_SIZE=1024
CONFIG_ESP_PHY_REDUCE_TX_POWER=y
CONFIG_ESP_SYSTEM_PANIC_PRINT_HALT=y
CONFIG_ESP_SYSTEM_EVENT_TASK_STACK_SIZE=3096
CONFIG_ESP_MAIN_TASK_STACK_SIZE=8192
CONFIG_ESP_INT_WDT_TIMEOUT_MS=800
CONFIG_ESP32_WIFI_STATIC_RX_BUFFER_NUM=12
CONFIG_ESP32_WIFI_DYNAMIC_RX_BUFFER_NUM=40
CONFIG_ESP32_WIFI_STATIC_TX_BUFFER_NUM=12
# CONFIG_ESP32_WIFI_AMPDU_TX_ENABLED is not set
# CONFIG_ESP32_WIFI_AMPDU_RX_ENABLED is not set
# CONFIG_ESP32_WIFI_IRAM_OPT is not set
# CONFIG_ESP32_WIFI_RX_IRAM_OPT is not set
# CONFIG_FMB_COMM_MODE_TCP_EN is not set
# CONFIG_FMB_COMM_MODE_RTU_EN is not set
# CONFIG_FMB_CONTROLLER_SLAVE_ID_SUPPORT is not set
CONFIG_FREERTOS_THREAD_LOCAL_STORAGE_POINTERS=2
CONFIG_FREERTOS_TIMER_TASK_STACK_DEPTH=3800
CONFIG_FREERTOS_GENERATE_RUN_TIME_STATS=y
CONFIG_FREERTOS_PLACE_FUNCTIONS_INTO_FLASH=y
CONFIG_HEAP_POISONING_COMPREHENSIVE=y
CONFIG_LWIP_LOCAL_HOSTNAME="SqueezeESP32"
# CONFIG_LWIP_IP4_FRAG is not set
CONFIG_LWIP_IP4_REASSEMBLY=y
CONFIG_LWIP_DHCP_RESTORE_LAST_IP=y
CONFIG_LWIP_TCP_SYNMAXRTX=6
CONFIG_LWIP_TCP_SND_BUF_DEFAULT=8192
CONFIG_LWIP_TCP_WND_DEFAULT=32768
CONFIG_LWIP_TCP_RECVMBOX_SIZE=32
CONFIG_LWIP_TCP_RTO_TIME=3000
CONFIG_LWIP_UDP_RECVMBOX_SIZE=32
# CONFIG_LWIP_ESP_LWIP_ASSERT is not set
CONFIG_MBEDTLS_DYNAMIC_BUFFER=y
CONFIG_MBEDTLS_TLS_CLIENT_ONLY=y
# CONFIG_MBEDTLS_SSL_PROTO_TLS1 is not set
# CONFIG_MBEDTLS_SSL_PROTO_TLS1_1 is not set
# CONFIG_MQTT_PROTOCOL_311 is not set
# CONFIG_MQTT_TRANSPORT_SSL is not set
# CONFIG_OPENSSL_ERROR_STACK is not set
CONFIG_OPENSSL_ASSERT_DO_NOTHING=y
CONFIG_PTHREAD_DEFAULT_CORE_1=y
# CONFIG_WS_TRANSPORT is not set
# CONFIG_VFS_SUPPORT_SELECT is not set
# CONFIG_VFS_SUPPORT_TERMIOS is not set
CONFIG_DSP_MAX_FFT_SIZE_512=y
CONFIG_BT_SINK=n
```

## components/wifi-manager/Kconfig.projbuild
```kconfig
menu "Network Manager Configuration"

    menu "WiFi Options"
        config WIFI_MANAGER_TASK_PRIORITY
            int "RTOS Task Priority for the wifi_manager"
            default 1
            help
            Tasks spawn by the manager will have a priority of WIFI_MANAGER_TASK_PRIORITY-1. For this particular reason, minimum recommended task priority is 2.

        config WIFI_MANAGER_MAX_RETRY
            int "Max Retry on failed connection"
            default 2
            help
            Defines when a connection is lost/attempt to connect is made, how many retries should be made before giving up.

        config DEFAULT_AP_SSID
            string "Access Point SSID"
            default "esp32"
            help
            SSID (network name) the the esp32 will broadcast.

        config DEFAULT_AP_PASSWORD
            string "Access Point Password"
            default "esp32pwd"
            help
            Password used for the Access Point. Leave empty and set AUTH MODE to WIFI_AUTH_OPEN for no password.

        config DEFAULT_AP_CHANNEL
            int "Access Point WiFi Channel"
            default 1
            help
            Be careful you might not see the access point if you use a channel not allowed in your country.

        config DEFAULT_AP_IP
            string "Access Point IP Address"
            default "10.10.0.1"
            help
            This is used for the redirection to the captive portal. It is recommended to leave unchanged.

        config DEFAULT_AP_GATEWAY
            string "Access Point IP Gateway"
            default "10.10.0.1"
            help
            This is used for the redirection to the captive portal. It is recommended to leave unchanged.

        config DEFAULT_AP_NETMASK
            string "Access Point Netmask"
            default "255.255.255.0"
            help
            This is used for the redirection to the captive portal. It is recommended to leave unchanged.

        config DEFAULT_AP_MAX_CONNECTIONS
            int "Access Point Max Connections"
            default 4
            help
            Max is 4.

        config DEFAULT_AP_BEACON_INTERVAL
            int "Access Point Beacon Interval (ms)"
            default 100
            help
            100ms is the recommended default.
    endmenu
    menu "Ethernet Options"
		visible if BASIC_I2C_BT && (ETH_USE_ESP32_EMAC || ETH_USE_SPI_ETHERNET)
		choice
			prompt "Ethernet Chipset"
			default ETH_NODRIVER
			config ETH_NODRIVER
				bool "Defined in NVS"
			config ETH_LAN8720
				bool "Microchip LAN8720 (RMII)"
			config ETH_DM9051
				bool "Davicom 9051 (SPI)"
			config ETH_W5500
				bool "WIZnet 5500 (SPI)"
		endchoice
        comment  "LAN8720 is an RMII interface and most of the required GPIOs aren't user selectable. They are defined as follow tx_en=21, tx0=19, tx1=22, rx0=25, rx1=26, crs_dv=27"
            depends on ETH_LAN8720
		config ETH_PHY_RST_IO
			int "PHY Reset GPIO number" if !ETH_NODRIVER
			default -1
			help
				Set the GPIO number used to reset PHY chip.
				Set to -1 to disable PHY chip hardware reset.
		config ETH_MDC_IO
			int "SMI MDC GPIO number" if ETH_LAN8720
			default -1
			help
				Set the GPIO number used by SMI MDC.
		config ETH_MDIO_IO
			int "SMI MDIO GPIO number" if ETH_LAN8720
			default -1
			help
				Set the GPIO number used by SMI MDIO.
		config ETH_SPI_HOST
			int "SPI host number (-1,1 or 2)" if ETH_DM9051 || ETH_W5500
			default -1
			help
				Set to -1 to use system's SPI config (see Various I/O)
				Set to 2 or 3 to use a dedicated bus
		config ETH_SPI_INTR_IO
			int "interrupt" if ETH_DM9051 || ETH_W5500
			default -1
		config ETH_SPI_CS_IO
			int "Chip Select" if ETH_DM9051 || ETH_W5500
			default -1
		config ETH_SPI_CLK_IO
			int "SPI clock" if ETH_SPI_HOST != -1 && (ETH_DM9051 || ETH_W5500)
			default -1
		config ETH_SPI_MOSI_IO
			int "Data Out" if ETH_SPI_HOST != -1 && (ETH_DM9051 || ETH_W5500)
			default -1
		config ETH_SPI_MISO_IO
			int "Data In"  if ETH_SPI_HOST != -1 && (ETH_DM9051 || ETH_W5500)
			default -1
		config ETH_SPI_SPEED
			int "SPI speed (Hz)" if ETH_SPI_HOST != -1 && (ETH_DM9051 || ETH_W5500)
			default 20000000
	endmenu

    config SQUEEZELITE_ESP32_METRICS
        bool "Enable Prometheus Metrics Endpoint"
        default y
        help
          Enable the /metrics endpoint which exposes system and application metrics
          in OpenMetrics/Prometheus format.
endmenu
```
